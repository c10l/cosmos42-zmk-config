## boards/shields/cosmos42/Kconfig.defconfig
```kconfig
if SHIELD_COSMOS42_LEFT

config ZMK_KEYBOARD_NAME
    default "cosmos42"

config ZMK_SPLIT_ROLE_CENTRAL
    default y

endif

if SHIELD_COSMOS42_LEFT || SHIELD_COSMOS42_RIGHT

config ZMK_SPLIT
    default y

endif
```

## boards/shields/cosmos42/Kconfig.shield
```kconfig
config SHIELD_COSMOS42_LEFT
    def_bool $(shields_list_contains,cosmos42_left)

config SHIELD_COSMOS42_RIGHT
    def_bool $(shields_list_contains,cosmos42_right)
```
